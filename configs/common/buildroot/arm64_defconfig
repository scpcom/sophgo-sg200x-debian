## configs/common/buildroot/arm64_defconfig
```kconfig
BR2_aarch64=y

BR2_TOOLCHAIN_EXTERNAL=y
BR2_TOOLCHAIN_EXTERNAL_ARM_AARCH64=y
BR2_TOOLCHAIN_EXTERNAL_DOWNLOAD=y
BR2_TOOLCHAIN_EXTERNAL_GDB_SERVER_COPY=y
BR2_OPTIMIZE_2=y
BR2_TARGET_LDFLAGS="-mcpu=cortex-a53 -mno-outline-atomics"

BR2_CCACHE=y
BR2_REPRODUCIBLE=y
BR2_PER_PACKAGE_DIRECTORIES=y

BR2_TARGET_GENERIC_HOSTNAME="licheervnano"
BR2_TARGET_GENERIC_ISSUE="Welcome to Linux"
BR2_TARGET_GENERIC_ROOT_PASSWD="root"

BR2_INIT_SYSV=y
BR2_ROOTFS_MERGED_USR=y
BR2_ENABLE_LOCALE_WHITELIST="C en_US en_US.utf8"
BR2_ROOTFS_DEVICE_CREATION_DYNAMIC_DEVTMPFS=y
# BR2_PACKAGE_BUSYBOX is not set
# BR2_PACKAGE_HOSTAPD_VLAN is not set
BR2_PACKAGE_LIBOPENSSL_BIN=y
BR2_PACKAGE_LIBOPENSSL_ENGINES=y
BR2_PACKAGE_MAIX_CDK=y
# BR2_PACKAGE_MAIX_CDK_ALL_DEPENDENCIES is not set
# BR2_PACKAGE_MAIX_CDK_ALL_EXAMPLES is not set
# BR2_PACKAGE_MAIX_CDK_ALL_PROJECTS is not set
BR2_PACKAGE_NANOKVM_SG200X=y
BR2_PACKAGE_OVERLAYFS_TOOLS=y
BR2_PACKAGE_MPG123=y
BR2_PACKAGE_CA_CERTIFICATES=y
BR2_PACKAGE_LIBCURL=y
BR2_PACKAGE_LIBCURL_CURL=y
BR2_PACKAGE_LIBCURL_VERBOSE=y
BR2_PACKAGE_LIBCURL_PROXY_SUPPORT=y
BR2_PACKAGE_LIBCURL_COOKIES_SUPPORT=y
BR2_PACKAGE_LIBCURL_WEBSOCKETS_SUPPORT=y
BR2_PACKAGE_LIBCURL_EXTRA_PROTOCOLS_FEATURES=y
BR2_PACKAGE_LIBCURL_OPENSSL=y
BR2_PACKAGE_LIBWEBSOCKETS=y
BR2_PACKAGE_NANOMSG=y
BR2_PACKAGE_WATCHDOG=y
BR2_PACKAGE_CVI_PINMUX=y
BR2_PACKAGE_CVI_PINMUX_SG200X=y
BR2_PACKAGE_DUO_PINMUX=y
BR2_PACKAGE_DUO_PINMUX_DUO256M=y
# BR2_PACKAGE_SOPHGO_LIBRARY is not set
# BR2_PACKAGE_TPUDEMO_SG200X is not set
BR2_PACKAGE_NCURSES_WCHAR=y
BR2_PACKAGE_UVC_GADGET=y

BR2_PACKAGE_JPEG=y
BR2_PACKAGE_OPENCV4=y
# BR2_PACKAGE_OPENCV4_LIB_CALIB3D is not set
# BR2_PACKAGE_OPENCV4_LIB_DNN is not set
BR2_PACKAGE_OPENCV4_LIB_HIGHGUI=y
# BR2_PACKAGE_OPENCV4_LIB_OBJDETECT is not set
BR2_PACKAGE_OPENCV4_LIB_PHOTO=y
BR2_PACKAGE_OPENCV4_LIB_SHAPE=y
# BR2_PACKAGE_OPENCV4_LIB_STITCHING is not set
BR2_PACKAGE_OPENCV4_LIB_SUPERRES=y
BR2_PACKAGE_OPENCV4_LIB_TS=y
# BR2_PACKAGE_OPENCV4_LIB_VIDEOSTAB is not set
# BR2_PACKAGE_OPENCV4_BUILD_TESTS is not set
# BR2_PACKAGE_OPENCV4_BUILD_PERF_TESTS is not set
BR2_PACKAGE_OPENCV4_WITH_FFMPEG=y
BR2_PACKAGE_OPENCV4_WITH_JPEG=y
BR2_PACKAGE_OPENCV4_WITH_PNG=y
# BR2_PACKAGE_OPENCV4_WITH_TBB is not set
# BR2_PACKAGE_OPENCV4_WITH_TIFF is not set
BR2_PACKAGE_OPENCV4_WITH_V4L=y
# BR2_PACKAGE_OPENCV4_WITH_WEBP is not set
BR2_PACKAGE_OPENCV4_INSTALL_DATA=y
BR2_PACKAGE_LIBQRENCODE=y
BR2_PACKAGE_LIBQRENCODE_TOOLS=y
BR2_PACKAGE_FFMPEG=y
BR2_PACKAGE_FFMPEG_FFMPEG=y
BR2_PACKAGE_FFMPEG_FFPROBE=y
BR2_PACKAGE_FFMPEG_GPL=y
BR2_PACKAGE_FFMPEG_NONFREE=y
BR2_PACKAGE_FFMPEG_POSTPROC=y
# BR2_PACKAGE_OPENCV4_LIB_PYTHON is not set
# BR2_PACKAGE_OPENCV4_WITH_QT5 is not set
BR2_PACKAGE_PYTHON3=y
BR2_PACKAGE_PYTHON3_2TO3=y
BR2_PACKAGE_PYTHON3_CODECSCJK=y
BR2_PACKAGE_PYTHON3_CURSES=y
BR2_PACKAGE_PYTHON3_READLINE=y
BR2_PACKAGE_PYTHON3_SSL=y
BR2_PACKAGE_PYTHON3_UNICODEDATA=y
BR2_PACKAGE_PYTHON3_PYEXPAT=y
BR2_PACKAGE_PYTHON3_XZ=y
BR2_PACKAGE_PYTHON3_ZLIB=y
BR2_PACKAGE_PYTHON3_PY_PYC=y

BR2_PACKAGE_HOST_PYTHON3=y
BR2_PACKAGE_HOST_PYTHON3_CURSES=y
BR2_PACKAGE_HOST_PYTHON3_SSL=y
BR2_PACKAGE_HOST_PYTHON3_XZ=y

BR2_PACKAGE_AXP2101=y

BR2_SYSTEM_BIN_SH_NONE=y

BR2_TARGET_ROOTFS_TAR=y
BR2_TARGET_ROOTFS_TAR_LZ4=y

BR2_ROOTFS_OVERLAY="$(TOPDIR)/board/cvitek/SG200X/overlay"

BR2_TARGET_TZ_INFO=y
BR2_TARGET_TZ_ZONELIST="default"
BR2_TARGET_LOCALTIME="Etc/UTC"
```

## configs/common/buildroot/riscv_defconfig
```kconfig
BR2_riscv=y
BR2_riscv_g=y
BR2_RISCV_ISA_RVC=y
BR2_RISCV_ABI_LP64D=y

BR2_TOOLCHAIN_EXTERNAL=y
BR2_TOOLCHAIN_EXTERNAL_CUSTOM=y
BR2_TOOLCHAIN_EXTERNAL_PREINSTALLED=y
BR2_TOOLCHAIN_EXTERNAL_CUSTOM_PREFIX="riscv64-unknown-linux-gnu"
BR2_TOOLCHAIN_EXTERNAL_CUSTOM_GLIBC=y
BR2_TOOLCHAIN_EXTERNAL_GCC_10=y
BR2_TOOLCHAIN_EXTERNAL_HEADERS_6_6=y
BR2_TOOLCHAIN_EXTERNAL_HAS_SSP=y
# BR2_TOOLCHAIN_EXTERNAL_INET_RPC is not set
BR2_TOOLCHAIN_EXTERNAL_CXX=y
BR2_TOOLCHAIN_EXTERNAL_FORTRAN=y
BR2_TOOLCHAIN_EXTERNAL_OPENMP=y
BR2_OPTIMIZE_2=y
BR2_TARGET_LDFLAGS="-mcpu=c906fdv -march=rv64imafdc -mcmodel=medany -mabi=lp64d"

BR2_CCACHE=y
BR2_REPRODUCIBLE=y
BR2_PER_PACKAGE_DIRECTORIES=y

BR2_TARGET_GENERIC_HOSTNAME="licheervnano"
BR2_TARGET_GENERIC_ISSUE="Welcome to Linux"
BR2_TARGET_GENERIC_ROOT_PASSWD="root"

BR2_INIT_SYSV=y
BR2_ROOTFS_MERGED_USR=y
BR2_ENABLE_LOCALE_WHITELIST="C en_US en_US.utf8"
BR2_ROOTFS_DEVICE_CREATION_DYNAMIC_DEVTMPFS=y
# BR2_PACKAGE_BUSYBOX is not set
# BR2_PACKAGE_HOSTAPD_VLAN is not set
BR2_PACKAGE_LIBOPENSSL_BIN=y
BR2_PACKAGE_LIBOPENSSL_ENGINES=y
BR2_PACKAGE_MAIX_CDK=y
# BR2_PACKAGE_MAIX_CDK_ALL_DEPENDENCIES is not set
# BR2_PACKAGE_MAIX_CDK_ALL_EXAMPLES is not set
# BR2_PACKAGE_MAIX_CDK_ALL_PROJECTS is not set
BR2_PACKAGE_NANOKVM_SG200X=y
BR2_PACKAGE_MPG123=y
BR2_PACKAGE_CA_CERTIFICATES=y
BR2_PACKAGE_LIBCURL=y
BR2_PACKAGE_LIBCURL_CURL=y
BR2_PACKAGE_LIBCURL_VERBOSE=y
BR2_PACKAGE_LIBCURL_PROXY_SUPPORT=y
BR2_PACKAGE_LIBCURL_COOKIES_SUPPORT=y
BR2_PACKAGE_LIBCURL_WEBSOCKETS_SUPPORT=y
BR2_PACKAGE_LIBCURL_EXTRA_PROTOCOLS_FEATURES=y
BR2_PACKAGE_LIBCURL_OPENSSL=y
BR2_PACKAGE_LIBWEBSOCKETS=y
BR2_PACKAGE_NANOMSG=y
BR2_PACKAGE_WATCHDOG=y
# BR2_PACKAGE_SOPHGO_LIBRARY is not set
# BR2_PACKAGE_TPUDEMO_SG200X is not set
BR2_PACKAGE_NCURSES_WCHAR=y
BR2_PACKAGE_UVC_GADGET=y

BR2_PACKAGE_JPEG=y
BR2_PACKAGE_OPENCV4=y
# BR2_PACKAGE_OPENCV4_LIB_CALIB3D is not set
# BR2_PACKAGE_OPENCV4_LIB_DNN is not set
BR2_PACKAGE_OPENCV4_LIB_HIGHGUI=y
# BR2_PACKAGE_OPENCV4_LIB_OBJDETECT is not set
BR2_PACKAGE_OPENCV4_LIB_PHOTO=y
BR2_PACKAGE_OPENCV4_LIB_SHAPE=y
# BR2_PACKAGE_OPENCV4_LIB_STITCHING is not set
BR2_PACKAGE_OPENCV4_LIB_SUPERRES=y
BR2_PACKAGE_OPENCV4_LIB_TS=y
# BR2_PACKAGE_OPENCV4_LIB_VIDEOSTAB is not set
# BR2_PACKAGE_OPENCV4_BUILD_TESTS is not set
# BR2_PACKAGE_OPENCV4_BUILD_PERF_TESTS is not set
BR2_PACKAGE_OPENCV4_WITH_FFMPEG=y
BR2_PACKAGE_OPENCV4_WITH_JPEG=y
BR2_PACKAGE_OPENCV4_WITH_PNG=y
# BR2_PACKAGE_OPENCV4_WITH_TBB is not set
# BR2_PACKAGE_OPENCV4_WITH_TIFF is not set
BR2_PACKAGE_OPENCV4_WITH_V4L=y
# BR2_PACKAGE_OPENCV4_WITH_WEBP is not set
BR2_PACKAGE_OPENCV4_INSTALL_DATA=y
BR2_PACKAGE_LIBQRENCODE=y
BR2_PACKAGE_LIBQRENCODE_TOOLS=y
BR2_PACKAGE_FFMPEG=y
BR2_PACKAGE_FFMPEG_FFMPEG=y
BR2_PACKAGE_FFMPEG_FFPROBE=y
BR2_PACKAGE_FFMPEG_GPL=y
BR2_PACKAGE_FFMPEG_NONFREE=y
BR2_PACKAGE_FFMPEG_POSTPROC=y
# BR2_PACKAGE_OPENCV4_LIB_PYTHON is not set
# BR2_PACKAGE_OPENCV4_WITH_QT5 is not set
BR2_PACKAGE_PYTHON3=y
BR2_PACKAGE_PYTHON3_2TO3=y
BR2_PACKAGE_PYTHON3_CODECSCJK=y
BR2_PACKAGE_PYTHON3_CURSES=y
BR2_PACKAGE_PYTHON3_READLINE=y
BR2_PACKAGE_PYTHON3_SSL=y
BR2_PACKAGE_PYTHON3_UNICODEDATA=y
BR2_PACKAGE_PYTHON3_PYEXPAT=y
BR2_PACKAGE_PYTHON3_XZ=y
BR2_PACKAGE_PYTHON3_ZLIB=y
BR2_PACKAGE_PYTHON3_PY_PYC=y

BR2_PACKAGE_HOST_PYTHON3=y
BR2_PACKAGE_HOST_PYTHON3_CURSES=y
BR2_PACKAGE_HOST_PYTHON3_SSL=y
BR2_PACKAGE_HOST_PYTHON3_XZ=y

BR2_PACKAGE_AXP2101=y

BR2_SYSTEM_BIN_SH_NONE=y

BR2_TARGET_ROOTFS_TAR=y
BR2_TARGET_ROOTFS_TAR_LZ4=y

BR2_ROOTFS_OVERLAY="$(TOPDIR)/board/cvitek/SG200X/overlay"

BR2_TARGET_TZ_INFO=y
BR2_TARGET_TZ_ZONELIST="default"
BR2_TARGET_LOCALTIME="Etc/UTC"
```
